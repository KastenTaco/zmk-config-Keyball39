## config/west.yml
```yaml
manifest:
  remotes:
    - name: zmkfirmware
      url-base: https://github.com/zmkfirmware
    - name: urob
      url-base: https://github.com/urob
    - name: tangbonze
      url-base: https://github.com/tangbonze
  projects:
    - name: zmk
      remote: zmkfirmware
      revision: v0.3 # Set to desired ZMK release.
      import: app/west.yml
    - name: zmk-helpers
      remote: urob
      revision: v0.3 # Should match ZMK release.
      import: app/west.yml
    - name: zmk-pmw3610-driver
      remote: tangbonze
      revision: main
  self:
    path: config
```
